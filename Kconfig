## Kconfig
```kconfig
mainmenu "CROPS Configuration"

source "os/Kconfig"
source "build/Kconfig"
source "container/Kconfig"
```

## build/repo/Kconfig
```kconfig
menu "Repo Management"
    config BUILDSYS_IN_CONTAINER
        bool "Include the build system (poky) on the container"
        default n

    config REPO_MANAGER_SCRIPT
        string 
        prompt "Repository Management Script"
        default "git-example.docker"
        depends on BUILDSYS_IN_CONTAINER
endmenu
```

## build/tc/Kconfig
```kconfig
menu "External Toolchain"
    config USE_EXTERNAL_TC
        bool "Use External Toolchain"
        default n
    config TC_MANAGER_SCRIPT
        string 
        prompt "Toolchain Docker Fragment"
        default "toolchain.docker"
        depends on USE_EXTERNAL_TC
    config TC_RUN_SCRIPT
        string 
        prompt "Toolchain Setup Bash Script"
        default "toolchain.run"
        depends on USE_EXTERNAL_TC
endmenu
```

## container/Kconfig
```kconfig
menu "Docker"
    config REGISTRY_URI
    string "Docker Registry URI"
        default "registry.hub.docker.com"

    config REGISTRY_PORT
    string "Docker Registry Port"
        default ""

    config REGISTRY_NAMESPACE
    string "Docker Registry Namespace"
        default "crops/poky"
    menu "Directory Configuration"
        config ENTRYPOINT_DIR
            string "Directory within this directory we store entrypoint scripts"
            default "config/entrypoints"
        config ENVS_DIR
            string "Directory within this directory we store env files"
            default "config/envs"
        config PACKAGES_PATH
            string "Path within this directory we store the packages file"
            default "config/pkgs"
        config REPO_INSTALL_PATH
            string "Path within this directory we store the packages file"
            default "config/repo"
    endmenu
endmenu
```

## os/Kconfig
```kconfig
menu "Host User"
    config USER
        string "Username"
        default "yoctouser"
    config WORKDIR
        string "User's Home Directory"
        default "/home/yoctouser"
    config CMD
        string "User shell (most often /bin/bash)"
        default "/bin/bash"
endmenu

menu "Host OS"

    choice OS
        prompt "Host OS"
        default DEBIAN
        config DEBIAN
            bool "Debian"
        config CENTOS
            bool "Centos"
        config FEDORA
            bool "Fedora"
        config UBUNTU
            bool "Ubuntu"
    endchoice

    menu "Debian Version"
    visible if DEBIAN
        choice DEBIAN_VERSION
            prompt "Debian Version"
            default DEBIAN_11
            config DEBIAN_11
                bool "Debian 11"
            config DEBIAN_10
                bool "Debian 10"
        endchoice
    endmenu

    menu "Ubuntu Version"
    visible if UBUNTU
        choice UBUNTU_VERSION
            prompt "Ubuntu Version"
            default UBUNTU_22
            config UBUNTU_22
                bool "Ubuntu 22"
            config UBUNTU_20
                bool "Ubuntu 20"
        endchoice
    endmenu
    
    menu "Fedora Version"
    visible if FEDORA
        choice FEDORA_VERSION
            prompt "Fedora Version"
            default FEDORA_36
            config FEDORA_36
                bool "Fedora 36"
        endchoice
    endmenu

    config HOST_OS_VERSION
    string
        default "11" if DEBIAN_11
        default "10" if DEBIAN_10
        default "22.04" if UBUNTU_22
        default "20.04" if UBUNTU_20
        default "centos7" if CENTOS
        default "36" if FEDORA_36

    config HOST_OS
    string
        default "debian" if DEBIAN
        default "ubuntu" if UBUNTU
        default "centos" if CENTOS
        default "fedora" if FEDORA

endmenu
```
